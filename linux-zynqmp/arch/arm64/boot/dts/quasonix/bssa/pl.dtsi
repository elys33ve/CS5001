/ {
	amba_pl: amba_pl@0 {
		#address-cells = <2>;
		#size-cells = <2>;
		compatible = "simple-bus";
		ranges ;
		misc_clk_0: misc_clk_0 {
			#clock-cells = <0>;
			clock-frequency = <299997000>;
			compatible = "fixed-clock";
		};
	};
};