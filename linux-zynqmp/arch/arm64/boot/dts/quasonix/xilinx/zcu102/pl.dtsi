/*
 * CAUTION: This file is automatically generated by Xilinx.
 * Version: XSCT 2021.1
 * Today is: Mon Nov 15 09:07:39 2021
 */


/ {
	amba_pl: amba_pl@0 {
		#address-cells = <2>;
		#size-cells = <2>;
		compatible = "simple-bus";
		ranges ;
		misc_clk_0: misc_clk_0 {
			#clock-cells = <0>;
			clock-frequency = <299997000>;
			compatible = "fixed-clock";
		};
	};
};
