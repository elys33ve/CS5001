/*
 * CAUTION: This file is automatically generated by Xilinx.
 * Version: XSCT 2021.1
 * Today is: Thu May 26 09:41:25 2022
 */


/ {
	amba_pl: amba_pl@0 {
		#address-cells = <2>;
		#size-cells = <2>;
		compatible = "simple-bus";
		ranges ;
		axi_gpio_0: gpio@802C0000 {
		        #gpio-cells = <2>;
			compatible = "xlnx,xps-gpio-1.00.a";
			gpio-controller ;
			reg = <0x0 0x802C0000 0x0 0x10000 >;
        		xlnx,all-inputs = <0x0>;
        		xlnx,dout-default = <0x01>;
        		xlnx,gpio-width = <32>;
        		xlnx,interrupt-present = <0>;
        		xlnx,is-dual = <0>;
			xlnx,tri-default = <0x0>;
		} ;			
		misc_clk_0: misc_clk_0 {
			#clock-cells = <0>;
			clock-frequency = <299997000>;
			compatible = "fixed-clock";
		};
	};
};
