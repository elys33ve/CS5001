/*
 * CAUTION: This file is automatically generated by Xilinx.
 * Version: XSCT 2020.2
 * Today is: Fri Feb 19 11:42:01 2021
 */


/dts-v1/;
#include "zynqmp.dtsi"
#include "zynqmp-clk-ccf.dtsi"
#include "pl.dtsi"
#include "pcw.dtsi"
/ {
	chosen {
		bootargs = "console=/dev/ttyPS0,115200 console=tty0 root=/dev/mmcblk1p2 loglevel=7 rw earlyprintk earlycon audit=0 clk_ignore_unused mem=2048M";
		stdout-path = "serial0:115200n8";
	};
	aliases {
		ethernet0 = &gem0;
		ethernet1 = &gem3;
		i2c0 = &i2c0;
		mmc0 = &sdhci0;
	        mmc1 = &sdhci1;
		serial0 = &uart0;
		spi0 = &qspi;
		usb0 = &usb0;
	};
	memory {
		device_type = "memory";
		reg = <0x0 0x0 0x0 0x80000000>, <0x8 0x00000000 0x0 0x80000000>;
	};
};

