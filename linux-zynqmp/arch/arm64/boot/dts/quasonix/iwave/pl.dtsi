/*
 * CAUTION: This file is automatically generated by Xilinx.
 * Version: XSCT 2021.1
 * Today is: Thu Feb 10 10:54:44 2022
 */


/ {
	amba_pl: amba_pl@0 {
		#address-cells = <2>;
		#size-cells = <2>;
		compatible = "simple-bus";
		ranges ;
		gpio_0: gpio@80000000 {
			/* This is a place holder node for a custom IP, user may need to update the entries */
			clock-names = "axi_lite_aclk";
			clocks = <&zynqmp_clk 72>;
			compatible = "xlnx,gpio-1.0";
			reg = <0x0 0x80000000 0x0 0x10000>;
			xlnx,axi-lite-addr-width = <0x6>;
			xlnx,axi-lite-data-width = <0x20>;
		};
	};
};
